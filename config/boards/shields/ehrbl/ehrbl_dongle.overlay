/*
 * Copyright (c) 2020 The ZMK Contributors
 *
 * SPDX-License-Identifier: MIT
 */

#include "ehrbl.overlay"

&kscan0 {
    #ifdef DIRECT
        input-gpios
            = <&gpio0 17 (GPIO_ACTIVE_LOW | GPIO_PULL_UP)>
            ;
    #else
        col-gpios
            = <&gpio0 17 (GPIO_ACTIVE_LOW | GPIO_PULL_UP)>
            ;
        row-gpios
            = <&gpio0 16 (GPIO_ACTIVE_LOW | GPIO_PULL_UP)>
            ;
    #endif
    };