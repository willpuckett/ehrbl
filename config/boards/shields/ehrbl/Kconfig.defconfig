## config/boards/shields/ehrbl/Kconfig.defconfig
```kconfig
# Copyright (c) 2022 The ZMK Contributors
# SPDX-License-Identifier: MIT

if SHIELD_EHRBL_DONGLE || SHIELD_EHRBL_LEFT_CENTRAL

config ZMK_KEYBOARD_NAME
    default "ehrbl dongle"

config ZMK_SPLIT_ROLE_CENTRAL
    default y

config ZMK_USB
	default y

endif

if SHIELD_EHRBL_LEFT_PERIPHERAL || SHIELD_EHRBL_LEFT_CENTRAL || SHIELD_EHRBL_RIGHT || SHIELD_EHRBL_DONGLE
config ZMK_SPLIT
    default y
config ZMK_BLE
	default y
endif
```

## config/boards/shields/ehrbl/Kconfig.shield
```kconfig
# Copyright (c) 2022 The ZMK Contributors
# SPDX-License-Identifier: MIT

config SHIELD_EHRBL_LEFT_CENTRAL
    def_bool $(shields_list_contains,ehrbl_left_central)

config SHIELD_EHRBL_LEFT_PERIPHERAL
    def_bool $(shields_list_contains,ehrbl_left_peripheral)

config SHIELD_EHRBL_RIGHT
    def_bool $(shields_list_contains,ehrbl_right)

config SHIELD_EHRBL_DONGLE
    def_bool $(shields_list_contains,ehrbl_dongle)
```
